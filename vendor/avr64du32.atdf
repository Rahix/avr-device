# AVR64DU32 device description
Architecture: AVR8X; Family: AVR
Programming and debug interfaces: UPDI
Registers are 8-bit, read-write, reset 0x0 unless marked. A register's access mark holds for its fields unless they carry their own. Offsets are from the block's base; lines under a group give offsets from that group; [hi:lo] are bit positions; {n}, {i} and the like mark numbered series; 'fields as' and 'values as' point back to an identical list; <NAME> marks a mode.

## Ordering variants
AVR64DU32-VQFN/TQFP: QFP32, pinout QFN32USB, up to 32 MHz, -40 to 85 C, 1.8 to 5.5 V

## Memory
data space: start 0x0000 size 0x10000, little endian
  0x00 IO size 0x103F io, rw
  0x1040 LOCKBITS size 0x04 lockbits, rw, page 0x1
  0x1050 FUSES size 0x10 fuses, rw, page 0x1
  0x1080 SIGNATURES size 0x03 signatures, ro, page 0x80
  0x1083 PROD_SIGNATURES size 0x7D signatures, ro, page 0x80
  0x1100 BOOTROW size 0x100 user_signatures, rw, page 0x100
  0x1200 USER_SIGNATURES size 0x200 user_signatures, rw, page 0x200
  0x1400 EEPROM size 0x100 eeprom, rw, page 0x1
  0x6000 INTERNAL_SRAM size 0x2000 ram, rw
  0x8000 MAPPED_PROGMEM size 0x8000 other, rw, page 0x200
prog space: start 0x0000 size 0x10000, little endian
  0x00 PROGMEM size 0x10000 flash, rw, executable, page 0x200

## Peripheral instances (address, pins/pin function, parameters)
AC0 at 0x0680 (AC)
  pins: AINN0 PD3; AINN1 PD0; AINN2 PD7; AINP0 PD2; AINP3 PD6; AINP4 PC3; OUT PA7
ADC0 at 0x0600 (ADC)
  pins: AIN{n} PD{n}/AIN0 (n=0..7); AIN16 PF0/AIN0; AIN17 PF1/AIN0; AIN18 PF2/AIN0; AIN19 PF3/AIN0; AIN20 PF4/AIN0; AIN21 PF5/AIN0; AIN22 PA2/AIN0; AIN23 PA3/AIN0; AIN24 PA4/AIN0; AIN25 PA5/AIN0; AIN26 PA6/AIN0; AIN27 PA7/AIN0; AIN31 PC3/AIN0
BOD at 0x00A0
BOOTROW at 0x1100
CCL at 0x01C0
  pins: LUT0_IN0 PA0 or PA0/CCL_ALT1; LUT0_IN1 PA1 or PA1/CCL_ALT1; LUT0_IN2 PA2 or PA2/CCL_ALT1; LUT0_OUT PA3 or PA6/CCL_ALT1; LUT1_OUT PC3; LUT2_IN0 PD0 or PD0/CCL_ALT1; LUT2_IN1 PD1 or PD1/CCL_ALT1; LUT2_IN2 PD2 or PD2/CCL_ALT1; LUT2_OUT PD3 or PD6/CCL_ALT1; LUT3_IN0 PF0; LUT3_IN1 PF1; LUT3_IN2 PF2; LUT3_OUT PF3
  pin routing set by: PORTMUX.CCLROUTEA.LUT0, PORTMUX.CCLROUTEA.LUT1, PORTMUX.CCLROUTEA.LUT2, PORTMUX.CCLROUTEA.LUT3
CLKCTRL at 0x0060
  pins: CLKOUT PA7; EXTCLK PA0; XTAL32K1 PF0 or PA0/CLKCTRL_ALT1; XTAL32K2 PF1 or PA1/CLKCTRL_ALT1; XTALHF1 PA0; XTALHF2 PA1
CPU at 0x0030
  parameters: CORE_VERSION=V4S
CPUINT at 0x0110
CRCSCAN at 0x0120
EVSYS at 0x0200
  pins: EVOUT0 PA2 or PA7/EVSYS_ALT1; EVOUT3 PD2 or PD7/EVSYS_ALT1; EVOUT5 PF2 or PF7/EVSYS_ALT1
  pin routing set by: PORTMUX.EVSYSROUTEA.EVOUTA, PORTMUX.EVSYSROUTEA.EVOUTD, PORTMUX.EVSYSROUTEA.EVOUTF
FUSE at 0x1050
GPR at 0x001C
LOCK at 0x1040
NVMCTRL at 0x1000
PORTA at 0x0400 (PORT)
  pins: PIN{n} PA{n}/IOPORT (n=0..7)
PORTC at 0x0440 (PORT)
  pins: PIN3 PC3/IOPORT
PORTD at 0x0460 (PORT)
  pins: PIN{n} PD{n}/IOPORT (n=0..7)
PORTF at 0x04A0 (PORT)
  pins: PIN{n} PF{n}/IOPORT (n=0..7)
PORTMUX at 0x05E0
RSTCTRL at 0x0040
  pins: RESET PF6/OTHER
RTC at 0x0140
SIGROW at 0x1080
SLPCTRL at 0x0050
SPI0 at 0x0940 (SPI)
  pins: MISO PA5 or PD5/SPI0_ALT4; MOSI PA4 or PD4/SPI0_ALT4; SCK PA6 or PD6/SPI0_ALT4; SS PA7 or PD7/SPI0_ALT4
  pin routing set by: PORTMUX.SPIROUTEA.SPI0
SYSCFG at 0x0F00
TCA0 at 0x0A00 (TCA)
  pins: WO0 PA0 or PD0/TCA0_ALT3 or PF0/TCA0_ALT5; WO1 PA1 or PD1/TCA0_ALT3 or PF1/TCA0_ALT5; WO2 PA2 or PD2/TCA0_ALT3 or PF2/TCA0_ALT5; WO3 PA3 or PC3/TCA0_ALT2 or PD3/TCA0_ALT3 or PF3/TCA0_ALT5; WO4 PA4 or PD4/TCA0_ALT3 or PF4/TCA0_ALT5; WO5 PA5 or PD5/TCA0_ALT3 or PF5/TCA0_ALT5
  pin routing set by: PORTMUX.TCAROUTEA.TCA0
TCB0 at 0x0B00 (TCB)
  pins: WO0 PA2 or PF4/TCB0_ALT1
  pin routing set by: PORTMUX.TCBROUTEA.TCB0
TCB1 at 0x0B10 (TCB)
  pins: WO0 PA3 or PF5/TCB1_ALT1
  pin routing set by: PORTMUX.TCBROUTEA.TCB1
TWI0 at 0x0900 (TWI)
  pins: SCL PA3/I2C0 or PA3/I2C0_ALT1 or PA1/I2C0_ALT3; SDA PA2/I2C0 or PA2/I2C0_ALT1 or PA0/I2C0_ALT3
  pin routing set by: PORTMUX.TWIROUTEA.TWI0
USART0 at 0x0800 (USART)
  pins: RXD PA1 or PA5/USART0_ALT1 or PA3/USART0_ALT2 or PD5/USART0_ALT3; TXD PA0 or PA4/USART0_ALT1 or PA2/USART0_ALT2 or PD4/USART0_ALT3; XCK PA2 or PA6/USART0_ALT1 or PD6/USART0_ALT3; XDIR PA3 or PA7/USART0_ALT1 or PD7/USART0_ALT3
  pin routing set by: PORTMUX.USARTROUTEA.USART0
USART1 at 0x0820 (USART)
  pins: RXD PD7/USART1_ALT2; TXD PD6/USART1_ALT2
  pin routing set by: PORTMUX.USARTROUTEA.USART1
USB0 at 0xC00 (USB)
  pins: DM DM; DP DP
  parameters: USB_MAX_ENDPOINTS=16
USERROW at 0x1200
VPORTA at 0x0000 (VPORT)
VPORTC at 0x0008 (VPORT)
VPORTD at 0x000C (VPORT)
VPORTF at 0x0014 (VPORT)
VREF at 0x00B0
WDT at 0x0100

## Interrupts
1 NMI (CRCSCAN)
2 VLM (BOD)
3 CFD (CLKCTRL)
4 CNT (RTC)
5 PIT (RTC)
6 CCL
7 BUSEVENT (USB0)
8 TRNCOMPL (USB0)
9 PORT (PORTA)
10 LUNF (TCA0)
10 OVF (TCA0)
11 HUNF (TCA0)
12 CMP0 (TCA0)
12 LCMP0 (TCA0)
13 CMP1 (TCA0)
13 LCMP1 (TCA0)
14 CMP2 (TCA0)
14 LCMP2 (TCA0)
15 INT (TCB0)
16 TWIS (TWI0)
17 TWIM (TWI0)
18 INT (SPI0)
19 RXC (USART0)
20 DRE (USART0)
21 TXC (USART0)
22 PORT (PORTD)
23 PORT (PORTC)
24 PORT (PORTF)
25 NVMREADY (NVMCTRL)
26 RXC (USART1)
27 DRE (USART1)
28 TXC (USART1)
29 INT (TCB1)
30 AC (AC0)
31 ERROR (ADC0)
32 RESRDY (ADC0)
33 SAMPRDY (ADC0)

## Properties
OCD_FEATURES: BREAK_PIN=PF6, BREAK_PIN_ALT=PF2
SIGNATURES: SIGNATURE0=0x1E, SIGNATURE1=0x96, SIGNATURE2=0x21

## Pinouts (pin number, pad)
QFN32USB: 1 PA3, 2 PA4, 3 PA5, 4 PA6, 5 PA7, 6 VUSB, 7 DM, 8 DP, 9 PC3, 10 PD0, 11 PD1, 12 PD2, 13 PD3, 14 PD4, 15 PD5, 16 PD6, 17 PD7, 18 VDD1, 19 GND1, 20 PF0, 21 PF1, 22 PF2, 23 PF3, 24 PF4, 25 PF5, 26 PF6, 27 PF7, 28 VDD0, 29 GND0, 30 PA0, 31 PA1, 32 PA2

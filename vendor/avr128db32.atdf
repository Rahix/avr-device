# AVR128DB32 device description
Architecture: AVR8X; Family: AVR
Programming and debug interfaces: UPDI
Registers are 8-bit, read-write, reset 0x0 unless marked. A register's access mark holds for its fields unless they carry their own. Offsets are from the block's base; lines under a group give offsets from that group; [hi:lo] are bit positions; {n}, {i} and the like mark numbered series; 'fields as' and 'values as' point back to an identical list; <NAME> marks a mode.

## Ordering variants
AVR128DB32-VQFN/TQFP: QFP32, up to 32 MHz, -40 to 125 C, 1.8 to 5.5 V

## Memory
data space: start 0x0000 size 0x10000, little endian
  0x00 IO size 0x103F io, rw
  0x1040 LOCKBITS size 0x04 lockbits, rw, page 0x1
  0x1050 FUSES size 0x10 fuses, rw, page 0x1
  0x1080 USER_SIGNATURES size 0x20 user_signatures, rw, page 0x20
  0x1100 SIGNATURES size 0x03 signatures, ro, page 0x80
  0x1103 PROD_SIGNATURES size 0x7D signatures, ro, page 0x80
  0x1400 EEPROM size 0x200 eeprom, rw, page 0x1
  0x4000 INTERNAL_SRAM size 0x4000 ram, rw
  0x8000 MAPPED_PROGMEM size 0x8000 other, rw, page 0x200
prog space: start 0x0000 size 0x20000, little endian
  0x00 PROGMEM size 0x20000 flash, rw, executable, page 0x200

## Peripheral instances (address, pins/pin function, parameters)
AC0 at 0x0680 (AC)
  pins: AINN PD3/AINN0 or PD7/AINN2; AINP PD2/AINP0 or PD6/AINP3; OUT PA7
  pin routing set by: AC0.MUXCTRL.MUXNEG, AC0.MUXCTRL.MUXPOS, PORTMUX.ACROUTEA.AC0
AC1 at 0x0688 (AC)
  pins: AINN PD5/AINN0 or PD7/AINN2; AINP PD2/AINP0 or PD3/AINP1 or PD4/AINP2 or PD6/AINP3; OUT PA7
  pin routing set by: AC1.MUXCTRL.MUXNEG, AC1.MUXCTRL.MUXPOS, PORTMUX.ACROUTEA.AC1
AC2 at 0x0690 (AC)
  pins: AINN PD7/AINN0 or PD7/AINN2; AINP PD2/AINP0 or PD4/AINP1 or PD6/AINP3; OUT PA7
  pin routing set by: AC2.MUXCTRL.MUXNEG, AC2.MUXCTRL.MUXPOS, PORTMUX.ACROUTEA.AC2
ADC0 at 0x0600 (ADC)
  pins: AINN PD1/AIN1 or PD2/AIN2 or PD3/AIN3 or PD4/AIN4 or PD5/AIN5 or PD6/AIN6 or PD7/AIN7; AINP PD1/AIN1 or PD2/AIN2 or PD3/AIN3 or PD4/AIN4 or PD5/AIN5 or PD6/AIN6 or PD7/AIN7 or PF0/AIN16 or PF1/AIN17 or PF2/AIN18 or PF3/AIN19 or PF4/AIN20 or PF5/AIN21
  pin routing set by: ADC0.MUXNEG.MUXNEG, ADC0.MUXPOS.MUXPOS
BOD at 0x00A0
CCL at 0x01C0
  pins: LUT0_IN0 PA0/IN0; LUT0_IN1 PA1/IN1; LUT0_IN2 PA2/IN2; LUT1_IN0 PC0/IN0; LUT1_IN1 PC1/IN1; LUT1_IN2 PC2/IN2; LUT2_IN1 PD1/IN1; LUT2_IN2 PD2/IN2; LUT3_IN0 PF0/IN0; LUT3_IN1 PF1/IN1; LUT3_IN2 PF2/IN2; LUT0_OUT PA6/ALT1 or PA3; LUT1_OUT PC3; LUT2_OUT PD6/ALT1 or PD3; LUT3_OUT PF3
  pin routing set by: CCL.LUT0CTRLB.INSEL0, CCL.LUT0CTRLB.INSEL1, CCL.LUT0CTRLC.INSEL2, CCL.LUT1CTRLB.INSEL0, CCL.LUT1CTRLB.INSEL1, CCL.LUT1CTRLC.INSEL2, CCL.LUT2CTRLB.INSEL1, CCL.LUT2CTRLC.INSEL2, CCL.LUT3CTRLB.INSEL0, CCL.LUT3CTRLB.INSEL1, CCL.LUT3CTRLC.INSEL2, PORTMUX.CCLROUTEA.LUT0, PORTMUX.CCLROUTEA.LUT1, PORTMUX.CCLROUTEA.LUT2, PORTMUX.CCLROUTEA.LUT3
CLKCTRL at 0x0060
  pins: CLKOUT PA7; EXTCLK PA0; XTAL32K1 PF0; XTAL32K2 PF1; XTALHF1 PA0; XTALHF2 PA1
CPU at 0x0030
  parameters: CORE_VERSION=V4S
CPUINT at 0x0110
CRCSCAN at 0x0120
DAC0 at 0x06A0 (DAC)
  pins: OUT PD6
EVSYS at 0x0200
  pins: EVOUTA PA7/ALT1 or PA2; EVOUTC PC2; EVOUTD PD7/ALT1 or PD2; EVOUTF PF2
  pin routing set by: PORTMUX.EVSYSROUTEA.EVOUTA, PORTMUX.EVSYSROUTEA.EVOUTC, PORTMUX.EVSYSROUTEA.EVOUTD, PORTMUX.EVSYSROUTEA.EVOUTF
FUSE at 0x1050
GPR at 0x001C
LOCK at 0x1040
MVIO at 0x00C0
NVMCTRL at 0x1000
OPAMP at 0x0700
  pins: OP0INN PD3; OP0INP PD1; OP0OUT PD2; OP1INN PD7; OP1INP PD4; OP1OUT PD5
PORTA at 0x0400 (PORT)
  pins: PIN{n} PA{n} (n=0..7)
PORTC at 0x0440 (PORT)
  pins: PIN0 PC0; PIN1 PC1; PIN2 PC2; PIN3 PC3
PORTD at 0x0460 (PORT)
  pins: PIN1 PD1; PIN2 PD2; PIN3 PD3; PIN4 PD4; PIN5 PD5; PIN6 PD6; PIN7 PD7
PORTF at 0x04A0 (PORT)
  pins: PIN0 PF0; PIN1 PF1; PIN2 PF2; PIN3 PF3; PIN4 PF4; PIN5 PF5; PIN6 PF6
PORTMUX at 0x05E0
RSTCTRL at 0x0040
  pins: RESET PF6
RTC at 0x0140
SIGROW at 0x1100
SLPCTRL at 0x0050
SPI0 at 0x0940 (SPI)
  pins: MISO PA5; MOSI PA4; SCK PA6; SS PA7
  pin routing set by: PORTMUX.SPIROUTEA.SPI0
SPI1 at 0x0960 (SPI)
  pins: MISO PC1; MOSI PC0; SCK PC2; SS PC3
  pin routing set by: PORTMUX.SPIROUTEA.SPI1
SYSCFG at 0x0F00
TCA0 at 0x0A00 (TCA)
  pins: WO0 PA0/PORTA or PC0/PORTC or PF0/PORTF; WO1 PA1/PORTA or PC1/PORTC or PD1/PORTD or PF1/PORTF; WO2 PA2/PORTA or PC2/PORTC or PD2/PORTD or PF2/PORTF; WO3 PA3/PORTA or PC3/PORTC or PD3/PORTD or PF3/PORTF; WO4 PA4/PORTA or PD4/PORTD or PF4/PORTF; WO5 PA5/PORTA or PD5/PORTD or PF5/PORTF
  pin routing set by: PORTMUX.TCAROUTEA.TCA0
TCB0 at 0x0B00 (TCB)
  pins: WO PF4/ALT1 or PA2
  pin routing set by: PORTMUX.TCBROUTEA.TCB0
TCB1 at 0x0B10 (TCB)
  pins: WO PF5/ALT1 or PA3
  pin routing set by: PORTMUX.TCBROUTEA.TCB1
TCB2 at 0x0B20 (TCB)
  pins: WO PC0
  pin routing set by: PORTMUX.TCBROUTEA.TCB2
TCD0 at 0x0B80 (TCD)
  pins: WOA PF0/ALT2 or PA4; WOB PF1/ALT2 or PA5; WOC PF2/ALT2 or PA6; WOD PF3/ALT2 or PA7
  pin routing set by: PORTMUX.TCDROUTEA.TCD0
TWI0 at 0x0900 (TWI)
  pins: SCL PA3/ALT1 or PC3/ALT2 or PA3; SDA PA2/ALT1 or PC2/ALT2 or PA2; SCL_DUAL PC3; SDA_DUAL PC2
  pin routing set by: PORTMUX.TWIROUTEA.TWI0
TWI1 at 0x0920 (TWI)
  pins: SCL PF3/ALT1 or PF3; SDA PF2/ALT1 or PF2
  pin routing set by: PORTMUX.TWIROUTEA.TWI1
USART0 at 0x0800 (USART)
  pins: RXD PA5/ALT1 or PA1; TXD PA4/ALT1 or PA0; XCK PA6/ALT1 or PA2; XDIR PA7/ALT1 or PA3
  pin routing set by: PORTMUX.USARTROUTEA.USART0
USART1 at 0x0820 (USART)
  pins: RXD PC1; TXD PC0; XCK PC2; XDIR PC3
  pin routing set by: PORTMUX.USARTROUTEA.USART1
USART2 at 0x0840 (USART)
  pins: RXD PF5/ALT1 or PF1; TXD PF4/ALT1 or PF0; XCK PF2; XDIR PF3
  pin routing set by: PORTMUX.USARTROUTEA.USART2
USERROW at 0x1080
VPORTA at 0x0000 (VPORT)
VPORTC at 0x0008 (VPORT)
VPORTD at 0x000C (VPORT)
VPORTF at 0x0014 (VPORT)
VREF at 0x00B0
  pins: VREFA PD7
WDT at 0x0100
ZCD0 at 0x06C0 (ZCD)
  pins: ZCIN PD1; OUT PA7
  pin routing set by: PORTMUX.ZCDROUTEA.ZCD0

## Interrupts
1 NMI (CRCSCAN)
2 VLM (BOD)
3 CFD (CLKCTRL)
4 MVIO
5 CNT (RTC)
6 PIT (RTC)
7 CCL
8 PORT (PORTA)
9 LUNF (TCA0)
9 OVF (TCA0)
10 HUNF (TCA0)
11 CMP0 (TCA0)
11 LCMP0 (TCA0)
12 CMP1 (TCA0)
12 LCMP1 (TCA0)
13 CMP2 (TCA0)
13 LCMP2 (TCA0)
14 INT (TCB0)
15 INT (TCB1)
16 OVF (TCD0)
17 TRIG (TCD0)
18 TWIS (TWI0)
19 TWIM (TWI0)
20 INT (SPI0)
21 RXC (USART0)
22 DRE (USART0)
23 TXC (USART0)
24 PORT (PORTD)
25 AC (AC0)
26 RESRDY (ADC0)
27 WCMP (ADC0)
28 ZCD (ZCD0)
29 AC (AC1)
30 PORT (PORTC)
31 INT (TCB2)
32 RXC (USART1)
33 DRE (USART1)
34 TXC (USART1)
35 PORT (PORTF)
36 EE (NVMCTRL)
37 INT (SPI1)
38 RXC (USART2)
39 DRE (USART2)
40 TXC (USART2)
41 AC (AC2)
42 TWIS (TWI1)
43 TWIM (TWI1)

## Properties
OCD_FEATURES: BREAK_PIN=PF6, BREAK_PIN_ALT=PF2
SIGNATURES: SIGNATURE0=0x1E, SIGNATURE1=0x97, SIGNATURE2=0x0D

## Pinouts (pin number, pad)
QFP32: 1 PA3, 2 PA4, 3 PA5, 4 PA6, 5 PA7, 6 PC0, 7 PC1, 8 PC2, 9 PC3, 10 VDDIO2, 11 PD1, 12 PD2, 13 PD3, 14 PD4, 15 PD5, 16 PD6, 17 PD7, 18 AVDD, 19 AGND, 20 PF0, 21 PF1, 22 PF2, 23 PF3, 24 PF4, 25 PF5, 26 PF6, 27 UPDI, 28 VDD0, 29 GND0, 30 PA0, 31 PA1, 32 PA2

# ATtiny1634 device description
Architecture: AVR8; Family: tinyAVR
Programming and debug interfaces: ISP, HVPP, debugWIRE
Registers are 8-bit, access not given, no defined reset value unless marked. A register's access mark holds for its fields unless they carry their own. Offsets are from the block's base; lines under a group give offsets from that group; [hi:lo] are bit positions; {n}, {i} and the like mark numbered series; 'fields as' and 'values as' point back to an identical list; <NAME> marks a mode.

## Ordering variants
ATtiny1634-MU, ATtiny1634-MUR, ATtiny1634R-MU, ATtiny1634R-MUR: QFN20, up to 12 MHz, -40 to 85 C, 1.8 to 5.5 V
ATtiny1634-MN, ATtiny1634-MNR: QFN20, up to 12 MHz, -40 to 105 C, 1.8 to 5.5 V
ATtiny1634-SU, ATtiny1634-SUR, ATtiny1634R-SU, ATtiny1634R-SUR: SOIC20, up to 12 MHz, -40 to 85 C, 1.8 to 5.5 V

## Memory
prog space: start 0x0000 size 0x4000, little endian
  0x0000 FLASH size 0x4000 flash, rw, executable, page 0x20
signatures space: start 0 size 3, little endian
  0 SIGNATURES size 3 signatures, ro
fuses space: start 0 size 0x0003, little endian
  0 FUSES size 0x0003 fuses, rw
lockbits space: start 0 size 0x0001, little endian
  0 LOCKBITS size 0x0001 lockbits, rw
data space: start 0x0000 size 0x0500, little endian
  0x0000 REGISTERS size 0x0020 regs
  0x0020 MAPPED_IO size 0x00e0 io
  0x0100 IRAM size 0x0400 ram
eeprom space: start 0x0000 size 0x0100, little endian
  0x0000 EEPROM size 0x0100 eeprom, rw, page 0x04
io space: start 0x00 size 0x40, little endian

## Peripheral instances (address, pins/pin function, parameters)
TWI at 0x00 — Two Wire Serial Interface
PORTB at 0x00 — I/O Port
PORTC at 0x00 — I/O Port
PORTA at 0x00 — I/O Port
ADC at 0x00 — Analog-to-Digital Converter
AC at 0x00 — Analog Comparator
EEPROM at 0x00
TC1 at 0x00 — Timer/Counter, 16-bit
TC0 at 0x00 — Timer/Counter, 8-bit
EXINT at 0x00 — External Interrupts
CPU at 0x00 — CPU Registers
  parameters: CORE_VERSION=V2, NEW_INSTRUCTIONS=lpm rd,z+
USI at 0x00 — Universal Serial Interface
USART0 at 0x00 — USART
USART1 at 0x00 — USART
WDT at 0x00 — Watchdog Timer
FUSE at 0 in fuses — Fuses
LOCKBIT at 0 in lockbits — Lockbits

## Interrupts
0 RESET — External Pin, Power-on Reset, Brown-out Reset and Watchdog Reset
1 INT0 — External Interrupt Request 0
2 PCINT0 — Pin Change Interrupt Request 0
3 PCINT1 — Pin Change Interrupt Request 1
4 PCINT2 — Pin Change Interrupt Request 2
5 WDT — Watchdog Time-out Interrupt
6 TIMER1_CAPT — Timer/Counter1 Capture Event
6 TIM1_CAPT — Timer/Counter1 Capture Event
7 TIMER1_COMPA — Timer/Counter1 Compare Match A
7 TIM1_COMPA — Timer/Counter1 Compare Match A
8 TIMER1_COMPB — Timer/Counter1 Compare Match B
8 TIM1_COMPB — Timer/Counter1 Compare Match B
9 TIMER1_OVF — Timer/Counter1 Overflow
9 TIM1_OVF — Timer/Counter1 Overflow
10 TIMER0_COMPA — TimerCounter0 Compare Match A
10 TIM0_COMPA — TimerCounter0 Compare Match A
11 TIMER0_COMPB — TimerCounter0 Compare Match B
11 TIM0_COMPB — TimerCounter0 Compare Match B
12 TIMER0_OVF — Timer/Counter0 Overflow
12 TIM0_OVF — Timer/Counter0 Overflow
13 ANA_COMP — Analog Comparator
14 ADC — ADC Conversion Complete
14 ADC_READY — ADC Conversion Complete
15 USART0_START
15 USART0_RXS — USART0, Start
16 USART0_RX — USART0, Rx Complete
16 USART0_RXC — USART0, Rx Complete
17 USART0_UDRE — USART0 Data Register Empty
17 USART0_DRE — USART0 Data Register Empty
18 USART0_TX — USART0, Tx Complete
18 USART0_TXC — USART0, Tx Complete
19 USART1_START
19 USART1_RXS — USART1, Start
20 USART1_RX — USART1, Rx Complete
20 USART1_RXC — USART1, Rx Complete
21 USART1_UDRE — USART1 Data Register Empty
21 USART1_DRE — USART1 Data Register Empty
22 USART1_TX — USART1, Tx Complete
22 USART1_TXC — USART1, Tx Complete
23 USI_START — USI Start Condition
23 USI_STR — USI Start Condition
24 USI_OVERFLOW
24 USI_OVF — USI Overflow
25 TWI_SLAVE — Two-wire Serial Interface
25 TWI — Two-wire Serial Interface
26 EE_RDY — EEPROM Ready
27 QTRIP — Touch Sensing

## Properties
SIGNATURES: SIGNATURE0=0x1e, SIGNATURE1=0x94, SIGNATURE2=0x12, JTAGID=0x9412
OCD: OCD_REVISION=1, OCD_DATAREG=0x2e, PROGBASE=0x0000, BUFFERS_PER_FLASH_PAGE=4
